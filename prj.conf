## CMakeLists.txt
```
# SPDX-License-Identifier: Apache-2.0

cmake_minimum_required(VERSION 3.20.0)

find_package(Zephyr REQUIRED HINTS $ENV{ZEPHYR_BASE})
project(dasai_mochi)

zephyr_library_sources_ifdef(CONFIG_USE_FRAMES_METHOD src/main_w_frames.c)
zephyr_library_sources_ifdef(CONFIG_USE_GIF_METHOD src/main_gif_fs.c)

add_subdirectory(src/gif_frames)
```

## Kconfig
```
# Copyright (c) 2023 Nordic Semiconductor ASA
# SPDX-License-Identifier: Apache-2.0

source "Kconfig.zephyr"

config USE_FRAMES_METHOD
	bool "uses frame method"
	help
	  this will compile the c file which will contain the frames as c headers.


config USE_GIF_METHOD
	bool "uses gif method"
	help
	  this will compile the c file which uses gifs with littlefs
```

## prj.conf
```kconfig
CONFIG_LV_Z_MEM_POOL_SIZE=65536
CONFIG_HEAP_MEM_POOL_SIZE=65536

CONFIG_LV_Z_SHELL=y
CONFIG_MAIN_STACK_SIZE=8192

CONFIG_DISPLAY=y
CONFIG_DISPLAY_LOG_LEVEL_ERR=y

CONFIG_INPUT=y

CONFIG_LOG=y
CONFIG_SHELL=y

CONFIG_LVGL=y
CONFIG_LV_USE_LOG=y
CONFIG_LV_USE_LABEL=y
CONFIG_LV_USE_ARC=y
CONFIG_LV_USE_MONKEY=y
CONFIG_LV_FONT_MONTSERRAT_14=y
CONFIG_LV_USE_GIF=y
CONFIG_LV_COLOR_DEPTH_1=y

# Filesystem for GIF storage
CONFIG_FLASH=y
CONFIG_FLASH_MAP=y
CONFIG_FLASH_PAGE_LAYOUT=y
CONFIG_FILE_SYSTEM=y
CONFIG_FILE_SYSTEM_LITTLEFS=y
CONFIG_FILE_SYSTEM_SHELL=y


CONFIG_LOG_BACKEND_FS=y
CONFIG_LOG_BACKEND_FS_FILE_SIZE=1024
CONFIG_LOG_BACKEND_FS_FILES_LIMIT=1

CONFIG_USE_GIF_METHOD=y

# LVGL filesystem support (auto-enabled when FILE_SYSTEM is enabled)
CONFIG_LV_Z_USE_FILESYSTEM=y
```

## boards/xiao_esp32s3_procpu.overlay
```dts
/*
 * LittleFS fstab overlay for dasai_mochi on XIAO ESP32S3
 */

/ {
	fstab {
		compatible = "zephyr,fstab";
		lfs1: lfs1 {
			compatible = "zephyr,fstab,littlefs";
			mount-point = "/lfs1";
			partition = <&storage_partition>;
			automount;

			read-size = <16>;
			prog-size = <16>;
			cache-size = <64>;
			lookahead-size = <32>;
			block-cycles = <512>;
		};
	};
};
```

## src/main.c
```c
/*
 * Copyright (c) 2018 Jan Van Winkel <jan.van_winkel@dxplore.eu>
 *
 * SPDX-License-Identifier: Apache-2.0
 */

#include <lvgl.h>
#include <zephyr/device.h>
#include <zephyr/devicetree.h>
#include <zephyr/drivers/display.h>
#include <zephyr/input/input.h>
#include <zephyr/kernel.h>
#define LOG_LEVEL CONFIG_LOG_DEFAULT_LEVEL
#include <zephyr/logging/log.h>
LOG_MODULE_REGISTER(app);

#include "gif_frames/include/gif_frames.h"
static const lv_image_dsc_t *adore_frames[] = {
    &adore_frame_000, &adore_frame_001, &adore_frame_002, &adore_frame_003,
    &adore_frame_004, &adore_frame_005, &adore_frame_006, &adore_frame_007,
    &adore_frame_008, &adore_frame_009, &adore_frame_010, &adore_frame_011,
    &adore_frame_012, &adore_frame_013, &adore_frame_014, &adore_frame_015,
    &adore_frame_016, &adore_frame_017, &adore_frame_018, &adore_frame_019,
    &adore_frame_020, &adore_frame_021, &adore_frame_022, &adore_frame_023,
    &adore_frame_024,
};

static const lv_image_dsc_t *buzzing_frames[] = {
    &buzzing_frame_000, &buzzing_frame_001, &buzzing_frame_002,
    &buzzing_frame_003, &buzzing_frame_004, &buzzing_frame_005,
    &buzzing_frame_006, &buzzing_frame_007, &buzzing_frame_008,
    &buzzing_frame_009, &buzzing_frame_010, &buzzing_frame_011,
    &buzzing_frame_012, &buzzing_frame_013, &buzzing_frame_014,
    &buzzing_frame_015, &buzzing_frame_016, &buzzing_frame_017,
    &buzzing_frame_018, &buzzing_frame_019, &buzzing_frame_020,
    &buzzing_frame_021, &buzzing_frame_022, &buzzing_frame_023,
    &buzzing_frame_024, &buzzing_frame_025, &buzzing_frame_026,
    &buzzing_frame_027, &buzzing_frame_028, &buzzing_frame_029,
    &buzzing_frame_030, &buzzing_frame_031, &buzzing_frame_032,
    &buzzing_frame_033, &buzzing_frame_034, &buzzing_frame_035,
    &buzzing_frame_036, &buzzing_frame_037, &buzzing_frame_038,
    &buzzing_frame_039, &buzzing_frame_040, &buzzing_frame_041,
    &buzzing_frame_042, &buzzing_frame_043, &buzzing_frame_044,
    &buzzing_frame_045, &buzzing_frame_046, &buzzing_frame_047,
    &buzzing_frame_048, &buzzing_frame_049, &buzzing_frame_050,
    &buzzing_frame_051, &buzzing_frame_052, &buzzing_frame_053,
    &buzzing_frame_054, &buzzing_frame_055, &buzzing_frame_056,
    &buzzing_frame_057, &buzzing_frame_058, &buzzing_frame_059,
    &buzzing_frame_060, &buzzing_frame_061, &buzzing_frame_062,
    &buzzing_frame_063, &buzzing_frame_064, &buzzing_frame_065,
    &buzzing_frame_066,
};

static const lv_image_dsc_t *dizzy_frames[] = {
    &dizzy_frame_000, &dizzy_frame_001, &dizzy_frame_002, &dizzy_frame_003,
    &dizzy_frame_004, &dizzy_frame_005, &dizzy_frame_006, &dizzy_frame_007,
    &dizzy_frame_008, &dizzy_frame_009, &dizzy_frame_010, &dizzy_frame_011,
    &dizzy_frame_012, &dizzy_frame_013, &dizzy_frame_014, &dizzy_frame_015,
    &dizzy_frame_016, &dizzy_frame_017, &dizzy_frame_018, &dizzy_frame_019,
    &dizzy_frame_020, &dizzy_frame_021, &dizzy_frame_022, &dizzy_frame_023,
    &dizzy_frame_024, &dizzy_frame_025, &dizzy_frame_026, &dizzy_frame_027,
    &dizzy_frame_028, &dizzy_frame_029, &dizzy_frame_030, &dizzy_frame_031,
    &dizzy_frame_032, &dizzy_frame_033, &dizzy_frame_034, &dizzy_frame_035,
    &dizzy_frame_036, &dizzy_frame_037, &dizzy_frame_038, &dizzy_frame_039,
    &dizzy_frame_040, &dizzy_frame_041, &dizzy_frame_042, &dizzy_frame_043,
    &dizzy_frame_044, &dizzy_frame_045, &dizzy_frame_046,
};

static const lv_image_dsc_t *down_frames[] = {
    &down_frame_000, &down_frame_001, &down_frame_002, &down_frame_003,
    &down_frame_004, &down_frame_005, &down_frame_006, &down_frame_007,
    &down_frame_008, &down_frame_009, &down_frame_010, &down_frame_011,
    &down_frame_012, &down_frame_013, &down_frame_014, &down_frame_015,
    &down_frame_016, &down_frame_017, &down_frame_018, &down_frame_019,
    &down_frame_020, &down_frame_021, &down_frame_022, &down_frame_023,
    &down_frame_024, &down_frame_025, &down_frame_026, &down_frame_027,
    &down_frame_028, &down_frame_029, &down_frame_030, &down_frame_031,
    &down_frame_032, &down_frame_033, &down_frame_034, &down_frame_035,
    &down_frame_036, &down_frame_037, &down_frame_038, &down_frame_039,
    &down_frame_040, &down_frame_041, &down_frame_042, &down_frame_043,
    &down_frame_044, &down_frame_045, &down_frame_046,
};

static const lv_image_dsc_t *energetic_frames[] = {
    &energetic_frame_000, &energetic_frame_001, &energetic_frame_002,
    &energetic_frame_003, &energetic_frame_004, &energetic_frame_005,
    &energetic_frame_006, &energetic_frame_007, &energetic_frame_008,
    &energetic_frame_009, &energetic_frame_010, &energetic_frame_011,
    &energetic_frame_012, &energetic_frame_013, &energetic_frame_014,
    &energetic_frame_015, &energetic_frame_016, &energetic_frame_017,
    &energetic_frame_018, &energetic_frame_019, &energetic_frame_020,
    &energetic_frame_021, &energetic_frame_022, &energetic_frame_023,
    &energetic_frame_024, &energetic_frame_025, &energetic_frame_026,
    &energetic_frame_027, &energetic_frame_028, &energetic_frame_029,
    &energetic_frame_030, &energetic_frame_031, &energetic_frame_032,
    &energetic_frame_033, &energetic_frame_034, &energetic_frame_035,
    &energetic_frame_036, &energetic_frame_037, &energetic_frame_038,
    &energetic_frame_039, &energetic_frame_040, &energetic_frame_041,
    &energetic_frame_042, &energetic_frame_043, &energetic_frame_044,
    &energetic_frame_045, &energetic_frame_046, &energetic_frame_047,
    &energetic_frame_048, &energetic_frame_049, &energetic_frame_050,
    &energetic_frame_051, &energetic_frame_052, &energetic_frame_053,
    &energetic_frame_054, &energetic_frame_055, &energetic_frame_056,
    &energetic_frame_057, &energetic_frame_058, &energetic_frame_059,
    &energetic_frame_060, &energetic_frame_061, &energetic_frame_062,
    &energetic_frame_063, &energetic_frame_064, &energetic_frame_065,
    &energetic_frame_066, &energetic_frame_067, &energetic_frame_068,
    &energetic_frame_069, &energetic_frame_070, &energetic_frame_071,
    &energetic_frame_072, &energetic_frame_073, &energetic_frame_074,
    &energetic_frame_075, &energetic_frame_076, &energetic_frame_077,
    &energetic_frame_078, &energetic_frame_079, &energetic_frame_080,
    &energetic_frame_081, &energetic_frame_082, &energetic_frame_083,
    &energetic_frame_084, &energetic_frame_085, &energetic_frame_086,
    &energetic_frame_087, &energetic_frame_088, &energetic_frame_089,
    &energetic_frame_090, &energetic_frame_091, &energetic_frame_092,
    &energetic_frame_093, &energetic_frame_094, &energetic_frame_095,
    &energetic_frame_096, &energetic_frame_097, &energetic_frame_098,
};

static const lv_image_dsc_t *happ_frames[] = {
    &happ_frame_000, &happ_frame_001, &happ_frame_002, &happ_frame_003,
    &happ_frame_004, &happ_frame_005, &happ_frame_006, &happ_frame_007,
    &happ_frame_008, &happ_frame_009, &happ_frame_010, &happ_frame_011,
    &happ_frame_012, &happ_frame_013, &happ_frame_014, &happ_frame_015,
    &happ_frame_016, &happ_frame_017, &happ_frame_018, &happ_frame_019,
    &happ_frame_020, &happ_frame_021, &happ_frame_022, &happ_frame_023,
    &happ_frame_024, &happ_frame_025, &happ_frame_026, &happ_frame_027,
    &happ_frame_028, &happ_frame_029, &happ_frame_030, &happ_frame_031,
    &happ_frame_032, &happ_frame_033, &happ_frame_034, &happ_frame_035,
    &happ_frame_036, &happ_frame_037, &happ_frame_038, &happ_frame_039,
    &happ_frame_040, &happ_frame_041, &happ_frame_042, &happ_frame_043,
    &happ_frame_044, &happ_frame_045, &happ_frame_046, &happ_frame_047,
    &happ_frame_048, &happ_frame_049, &happ_frame_050, &happ_frame_051,
    &happ_frame_052, &happ_frame_053, &happ_frame_054, &happ_frame_055,
    &happ_frame_056, &happ_frame_057, &happ_frame_058, &happ_frame_059,
    &happ_frame_060, &happ_frame_061, &happ_frame_062, &happ_frame_063,
    &happ_frame_064, &happ_frame_065, &happ_frame_066, &happ_frame_067,
    &happ_frame_068, &happ_frame_069, &happ_frame_070, &happ_frame_071,
    &happ_frame_072, &happ_frame_073, &happ_frame_074,
};

static const lv_image_dsc_t *squint_frames[] = {
    &squint_frame_000, &squint_frame_001, &squint_frame_002, &squint_frame_003,
    &squint_frame_004, &squint_frame_005, &squint_frame_006, &squint_frame_007,
    &squint_frame_008, &squint_frame_009, &squint_frame_010, &squint_frame_011,
    &squint_frame_012, &squint_frame_013, &squint_frame_014, &squint_frame_015,
    &squint_frame_016, &squint_frame_017, &squint_frame_018, &squint_frame_019,
    &squint_frame_020, &squint_frame_021, &squint_frame_022, &squint_frame_023,
    &squint_frame_024, &squint_frame_025, &squint_frame_026, &squint_frame_027,
    &squint_frame_028, &squint_frame_029, &squint_frame_030, &squint_frame_031,
    &squint_frame_032, &squint_frame_033, &squint_frame_034, &squint_frame_035,
    &squint_frame_036, &squint_frame_037, &squint_frame_038, &squint_frame_039,
};

static const lv_image_dsc_t *sparkle_frames[] = {
    &sparkle_frame_000, &sparkle_frame_001, &sparkle_frame_002,
    &sparkle_frame_003, &sparkle_frame_004, &sparkle_frame_005,
    &sparkle_frame_006, &sparkle_frame_007, &sparkle_frame_008,
    &sparkle_frame_009, &sparkle_frame_010, &sparkle_frame_011,
    &sparkle_frame_012, &sparkle_frame_013, &sparkle_frame_014,
    &sparkle_frame_015, &sparkle_frame_016, &sparkle_frame_017,
    &sparkle_frame_018, &sparkle_frame_019, &sparkle_frame_020,
    &sparkle_frame_021, &sparkle_frame_022, &sparkle_frame_023,
    &sparkle_frame_024, &sparkle_frame_025, &sparkle_frame_026,
    &sparkle_frame_027, &sparkle_frame_028, &sparkle_frame_029,
    &sparkle_frame_030, &sparkle_frame_031, &sparkle_frame_032,
    &sparkle_frame_033, &sparkle_frame_034, &sparkle_frame_035,
    &sparkle_frame_036, &sparkle_frame_037, &sparkle_frame_038,
    &sparkle_frame_039, &sparkle_frame_040, &sparkle_frame_041,
    &sparkle_frame_042, &sparkle_frame_043, &sparkle_frame_044,
};

static const lv_image_dsc_t *zephyr_frames[] = {
    &zephyr_frame_000, &zephyr_frame_001, &zephyr_frame_002, &zephyr_frame_003,
    &zephyr_frame_004, &zephyr_frame_005, &zephyr_frame_006, &zephyr_frame_007,
    &zephyr_frame_008, &zephyr_frame_009, &zephyr_frame_010, &zephyr_frame_011,
    &zephyr_frame_012, &zephyr_frame_013, &zephyr_frame_014, &zephyr_frame_015,
};

static const lv_image_dsc_t *microchip_frames[] = {
    &microchip_frame_000, &microchip_frame_001, &microchip_frame_002,
    &microchip_frame_003, &microchip_frame_004, &microchip_frame_005,
    &microchip_frame_006, &microchip_frame_007, &microchip_frame_008,
    &microchip_frame_009, &microchip_frame_010, &microchip_frame_011,
    &microchip_frame_012, &microchip_frame_013, &microchip_frame_014,
    &microchip_frame_015,
};

static const lv_image_dsc_t *zephyr_mchp_scroll_frames[] = {
    &zephyr_mchp_scroll_frame_000, &zephyr_mchp_scroll_frame_001,
    &zephyr_mchp_scroll_frame_002, &zephyr_mchp_scroll_frame_003,
    &zephyr_mchp_scroll_frame_004, &zephyr_mchp_scroll_frame_005,
    &zephyr_mchp_scroll_frame_006, &zephyr_mchp_scroll_frame_007,
    &zephyr_mchp_scroll_frame_008, &zephyr_mchp_scroll_frame_009,
    &zephyr_mchp_scroll_frame_010, &zephyr_mchp_scroll_frame_011,
    &zephyr_mchp_scroll_frame_012, &zephyr_mchp_scroll_frame_013,
    &zephyr_mchp_scroll_frame_014, &zephyr_mchp_scroll_frame_015,
    &zephyr_mchp_scroll_frame_016, &zephyr_mchp_scroll_frame_017,
    &zephyr_mchp_scroll_frame_018, &zephyr_mchp_scroll_frame_019,
    &zephyr_mchp_scroll_frame_020, &zephyr_mchp_scroll_frame_021,
    &zephyr_mchp_scroll_frame_022, &zephyr_mchp_scroll_frame_023,
    &zephyr_mchp_scroll_frame_024, &zephyr_mchp_scroll_frame_025,
    &zephyr_mchp_scroll_frame_026, &zephyr_mchp_scroll_frame_027,
    &zephyr_mchp_scroll_frame_028, &zephyr_mchp_scroll_frame_029,
    &zephyr_mchp_scroll_frame_030, &zephyr_mchp_scroll_frame_031,
};

static const lv_image_dsc_t **frames = adore_frames;

#define FRAME_COUNT 24

static lv_obj_t *img;
static uint8_t current_frame = 0;
// todo: have a method to calculate the number of frames
static uint8_t frame_max_count = 0;

static void anim_cb(lv_timer_t *t) {
  current_frame++;
  if (current_frame >= frame_max_count) {
    current_frame = 0;
  }
  lv_image_set_src(img, frames[current_frame]);
}

static void on_button_press(struct input_event *evt, void *user_data) {
  static int8_t type = 0;

  if (evt->code == INPUT_REL_WHEEL) {
    type = type + evt->value;
  }

  type = (type < 0) ? 10 : type;
  type = (type > 10) ? 0 : type;

  switch (type) {
  case 0:
    frames = adore_frames;
    frame_max_count = 24;
    break;
  case 1:
    frames = buzzing_frames;
    frame_max_count = 66;
    break;
  case 2:
    frames = dizzy_frames;
    frame_max_count = 46;
    break;
  case 3:
    frames = down_frames;
    frame_max_count = 46;
    break;
  case 4:
    frames = energetic_frames;
    frame_max_count = 98;
    break;
  case 5:
    frames = happ_frames;
    frame_max_count = 74;
    break;
  case 6:
    frames = sparkle_frames;
    frame_max_count = 44;
    break;
  case 7:
    frames = squint_frames;
    frame_max_count = 39;
    break;
  case 8:
    frames = zephyr_frames;
    frame_max_count = 16;
    break;
  case 9:
    frames = microchip_frames;
    frame_max_count = 16;
    break;
  case 10:
    frames = zephyr_mchp_scroll_frames;
    frame_max_count = 32;
    break;
  default:
    printf("njn defaultil kudungi %d\n", type);
  }
  printf("mone enne vilichittund %d\n", type);
}

INPUT_CALLBACK_DEFINE(NULL, on_button_press, NULL);

int main(void) {
  const struct device *display_dev;
  int ret;

  display_dev = DEVICE_DT_GET(DT_CHOSEN(zephyr_display));
  if (!device_is_ready(display_dev)) {
    LOG_ERR("Device not ready, aborting test");
    return 0;
  }

  ret = display_blanking_off(display_dev);
  if (ret < 0 && ret != -ENOSYS) {
    LOG_ERR("Failed to turn blanking off (error %d)", ret);
    return 0;
  }
  /* Create image object */
  img = lv_image_create(lv_screen_active());
  lv_image_set_src(img, frames[0]);
  lv_obj_center(img);

  /* Create animation timer - 100ms per frame = 10 FPS */
  lv_timer_create(anim_cb, 100, NULL);

  while (1) {
    lv_timer_handler();
    k_sleep(K_MSEC(10));
  }
}
```

## src/frame_000.c
```c
#if defined(LV_LVGL_H_INCLUDE_SIMPLE)
#include "lvgl.h"
#elif defined(LV_LVGL_H_INCLUDE_SYSTEM)
#include <lvgl.h>
#elif defined(LV_BUILD_TEST)
#include "../lvgl.h"
#else
#include <lvgl.h>
#endif

#ifndef LV_ATTRIBUTE_MEM_ALIGN
#define LV_ATTRIBUTE_MEM_ALIGN
#endif

#ifndef LV_ATTRIBUTE_FRAME_000
#define LV_ATTRIBUTE_FRAME_000
#endif

static const
LV_ATTRIBUTE_MEM_ALIGN LV_ATTRIBUTE_LARGE_CONST LV_ATTRIBUTE_FRAME_000
uint8_t frame_000_map[] = {

    0x57,0x24,0x0b,0xff,0xff,0xf8,0xea,0xff,

    0x00,0x00,0x00,0x00,0x00,0x00,0x00,0x00,0x00,0x00,0x3f,0xff,0xff,0x80,0x00,0x00,
    0x00,0x00,0x00,0x00,0x00,0x00,0x00,0x00,0x00,0x00,0x3f,0xff,0xff,0xc0,0x00,0x00,
    0x00,0x00,0x00,0x00,0x00,0x00,0x00,0x02,0xa0,0x00,0x7f,0xff,0xff,0xe0,0x00,0x00,
    0x00,0x00,0x00,0x00,0x00,0x00,0x00,0x07,0xfe,0x00,0x7f,0xff,0xff,0xe0,0x00,0x00,
    0x00,0x00,0x00,0x00,0x00,0x00,0x00,0x7f,0xff,0x80,0x7f,0xff,0xff,0xf0,0x00,0x00,
    0x00,0x00,0x00,0x00,0x00,0x00,0x01,0xff,0xff,0xc0,0x7f,0xff,0xff,0xf0,0x00,0x00,
    0x00,0x00,0x00,0x00,0x00,0x00,0x03,0xff,0xff,0xe0,0x7f,0xff,0xff,0xf0,0x00,0x00,
    0x00,0x00,0x00,0x00,0x00,0x00,0x07,0xff,0xff,0xf0,0x7f,0xff,0xff,0xf8,0x00,0x00,
    0x00,0x00,0x00,0x00,0x00,0x00,0x1f,0xff,0xff,0xf0,0x7f,0xff,0xff,0xf8,0x00,0x00,
    0x00,0x00,0x00,0x00,0x00,0x00,0x1f,0xff,0xff,0xf0,0x7f,0xff,0xff,0xfc,0x00,0x00,
    0x00,0x00,0x00,0x00,0x00,0x00,0x3f,0xff,0xff,0xf0,0x3f,0xff,0xff,0xf8,0x00,0x00,
    0x00,0x00,0x00,0x00,0xa0,0x00,0x7f,0xff,0x5f,0xf0,0x3f,0xff,0xff,0xfc,0x00,0x00,
    0x00,0x00,0x00,0x3f,0xff,0x00,0xff,0xe0,0x03,0xf0,0x3f,0xff,0xff,0xfc,0x00,0x00,
    0x00,0x00,0x03,0xff,0xff,0xfc,0x7f,0xc0,0x01,0xec,0x3f,0xff,0xff,0xfc,0x00,0x00,
    0x00,0x00,0x0f,0xff,0xff,0xfa,0xff,0x00,0x00,0x7c,0x3f,0xff,0xff,0xfe,0x00,0x00,
    0x00,0x00,0x0f,0xff,0xff,0xfc,0xff,0x00,0x00,0x7c,0x1f,0xff,0xff,0xfc,0x00,0x00,
    0x00,0x00,0x1f,0xff,0xff,0xfe,0xfe,0x00,0x00,0x38,0x3f,0xff,0xff,0xfe,0x00,0x00,
    0x00,0x00,0x0f,0xff,0xff,0xfc,0xfc,0x00,0x00,0x00,0x1f,0xff,0xff,0xfe,0x00,0x00,
    0x00,0x00,0x1f,0xff,0xff,0xfc,0x78,0x00,0x00,0x00,0x3f,0xff,0xff,0xfe,0x00,0x00,
    0x00,0x00,0x1f,0xff,0xff,0xfe,0x00,0x00,0x00,0x00,0x1f,0xff,0xff,0xfe,0x00,0x00,
    0x00,0x00,0x3f,0xff,0xff,0xfc,0x00,0x00,0x00,0x00,0x1f,0xff,0xff,0xfe,0x00,0x00,
    0x00,0x00,0x3f,0xff,0xff,0xfc,0x00,0x00,0x00,0x00,0x1f,0xff,0xff,0xfe,0x00,0x00,
    0x00,0x00,0x3f,0xff,0xff,0xfc,0x00,0x00,0x00,0x00,0x1f,0xff,0xff,0xfe,0x00,0x00,
    0x00,0x00,0x3f,0xff,0xff,0xfc,0x00,0x00,0x00,0x00,0x1f,0xff,0xff,0xfe,0x00,0x00,
    0x00,0x00,0x3f,0xff,0xff,0xfc,0x00,0x00,0x00,0x00,0x0f,0xff,0xff,0xfe,0x00,0x00,
    0x00,0x00,0x3f,0xff,0xff,0xfc,0x00,0x00,0x00,0x00,0x1f,0xff,0xff,0xfe,0x00,0x00,
    0x00,0x00,0x3f,0xff,0xff,0xfc,0x00,0x00,0x00,0x00,0x1f,0xff,0xff,0xfe,0x00,0x00,
    0x00,0x00,0x3f,0xff,0xff,0xfc,0x00,0x00,0x00,0x00,0x1f,0xff,0xff,0xfe,0x00,0x00,
    0x00,0x00,0x3f,0xff,0xff,0xfc,0x00,0x00,0x00,0x00,0x1f,0xff,0xff,0xfe,0x00,0x00,
    0x00,0x00,0x3f,0xff,0xff,0xfc,0x00,0x00,0x00,0x00,0x1f,0xff,0xff,0xfc,0x00,0x00,
    0x00,0x00,0x3f,0xff,0xff,0xfc,0x00,0x00,0x00,0x00,0x1f,0xff,0xff,0xfe,0x00,0x00,
    0x00,0x00,0x3f,0xff,0xff,0xfc,0x00,0x00,0x00,0x00,0x1f,0xff,0xff,0xfc,0x00,0x00,
    0x00,0x00,0x3f,0xff,0xff,0xfc,0x00,0x00,0x00,0x00,0x1f,0xff,0xff,0xfc,0x00,0x00,
    0x00,0x00,0x3f,0xff,0xff,0xfc,0x00,0x00,0x00,0x00,0x1f,0xff,0xff,0xfc,0x00,0x00,
    0x00,0x00,0x3f,0xff,0xff,0xfc,0x00,0x00,0x00,0x00,0x1f,0xff,0xff,0xfc,0x00,0x00,
    0x00,0x00,0x3f,0xff,0xff,0xfc,0x00,0x00,0x00,0x00,0x1f,0xff,0xff,0xf8,0x00,0x00,
    0x00,0x00,0x1f,0xff,0xff,0xfe,0x00,0x00,0x00,0x00,0x1f,0xff,0xff,0xf8,0x00,0x00,
    0x00,0x00,0x1f,0xff,0xff,0xfe,0x00,0x00,0x00,0x00,0x1f,0xff,0xff,0xf0,0x00,0x00,
    0x00,0x00,0x3f,0xff,0xff,0xfe,0x00,0x00,0x00,0x00,0x1f,0xff,0xff,0xf0,0x00,0x00,
    0x00,0x00,0x1f,0xff,0xff,0xfe,0x00,0x00,0x00,0x00,0x0f,0xff,0xff,0xe0,0x00,0x00,
    0x00,0x00,0x1f,0xff,0xff,0xfe,0x00,0x00,0x00,0x00,0x07,0xff,0xff,0xc0,0x00,0x00,
    0x00,0x00,0x0f,0xff,0xff,0xff,0x00,0x00,0x00,0x00,0x03,0xff,0xff,0xc0,0x00,0x00,
    0x00,0x00,0x1f,0xff,0xff,0xff,0x00,0x00,0x00,0x00,0x00,0x7f,0xff,0x00,0x00,0x00,
    0x00,0x00,0x0f,0xff,0xff,0xff,0x00,0x00,0x00,0x00,0x00,0x00,0x00,0x00,0x00,0x00,
    0x00,0x00,0x07,0xff,0xff,0xff,0x00,0x00,0x00,0x00,0x00,0x00,0x00,0x00,0x00,0x00,
    0x00,0x00,0x07,0xff,0xff,0xff,0x00,0x00,0x00,0x00,0x00,0x00,0x00,0x00,0x00,0x00,
    0x00,0x00,0x07,0xff,0xff,0xff,0x00,0x00,0x00,0x00,0x00,0x00,0x00,0x00,0x00,0x00,
    0x00,0x00,0x03,0xff,0xff,0xff,0x00,0x00,0x00,0x00,0x00,0x00,0x00,0x00,0x00,0x00,
    0x00,0x00,0x03,0xff,0xff,0xff,0x00,0x00,0x00,0x00,0x00,0x00,0x00,0x00,0x00,0x00,
    0x00,0x00,0x01,0xff,0xff,0xfe,0x00,0x00,0x00,0x00,0x00,0x00,0x00,0x00,0x00,0x00,
    0x00,0x00,0x00,0xff,0xff,0xfc,0x00,0x00,0x00,0x00,0x00,0x00,0x00,0x00,0x00,0x00,
    0x00,0x00,0x00,0x7f,0xff,0xf0,0x00,0x00,0x00,0x00,0x00,0x00,0x00,0x00,0x00,0x00,
    0x00,0x00,0x00,0x3f,0xff,0xc0,0x00,0x00,0x00,0x00,0x00,0x00,0x00,0x00,0x00,0x00,
    0x00,0x00,0x00,0x0f,0xff,0x00,0x00,0x00,0x00,0x00,0x00,0x00,0x00,0x00,0x00,0x00,
    0x00,0x00,0x00,0x00,0x60,0x00,0x00,0x00,0x00,0x00,0x00,0x00,0x00,0x00,0x00,0x00,
    0x00,0x00,0x00,0x00,0x00,0x00,0x00,0x00,0x00,0x00,0x00,0x00,0x00,0x00,0x00,0x00,
    0x00,0x00,0x00,0x00,0x00,0x00,0x00,0x00,0x00,0x00,0x00,0x00,0x00,0x00,0x00,0x00,
    0x00,0x00,0x00,0x00,0x00,0x00,0x00,0x00,0x00,0x00,0x00,0x00,0x00,0x00,0x00,0x00,
    0x00,0x00,0x00,0x00,0x00,0x00,0x00,0x00,0x00,0x00,0x00,0x00,0x00,0x00,0x00,0x00,
    0x00,0x00,0x00,0x00,0x00,0x00,0x00,0x00,0x00,0x00,0x00,0x00,0x00,0x00,0x00,0x00,
    0x00,0x00,0x00,0x00,0x00,0x00,0x00,0x00,0x00,0x00,0x00,0x00,0x00,0x00,0x00,0x00,
    0x00,0x00,0x00,0x00,0x00,0x00,0x00,0x00,0x00,0x00,0x00,0x00,0x00,0x00,0x00,0x00,
    0x00,0x00,0x00,0x00,0x00,0x00,0x00,0x00,0x00,0x00,0x00,0x00,0x00,0x00,0x00,0x00,
    0x00,0x00,0x00,0x00,0x00,0x00,0x00,0x00,0x00,0x00,0x00,0x00,0x00,0x00,0x00,0x00,

};

const lv_image_dsc_t frame_000 = {
  .header = {
    .magic = LV_IMAGE_HEADER_MAGIC,
    .cf = LV_COLOR_FORMAT_I1,
    .flags = 0,
    .w = 128,
    .h = 64,
    .stride = 16,
    .reserved_2 = 0,
  },
  .data_size = sizeof(frame_000_map),
  .data = frame_000_map,
  .reserved = NULL,
};
```

## src/frame_001.c
```c
#if defined(LV_LVGL_H_INCLUDE_SIMPLE)
#include "lvgl.h"
#elif defined(LV_LVGL_H_INCLUDE_SYSTEM)
#include <lvgl.h>
#elif defined(LV_BUILD_TEST)
#include "../lvgl.h"
#else
#include <lvgl.h>
#endif

#ifndef LV_ATTRIBUTE_MEM_ALIGN
#define LV_ATTRIBUTE_MEM_ALIGN
#endif

#ifndef LV_ATTRIBUTE_FRAME_001
#define LV_ATTRIBUTE_FRAME_001
#endif

static const
LV_ATTRIBUTE_MEM_ALIGN LV_ATTRIBUTE_LARGE_CONST LV_ATTRIBUTE_FRAME_001
uint8_t frame_001_map[] = {

    0xfb,0xeb,0xcf,0x1f,0x58,0x25,0x0c,0xff,

    0x20,0x00,0x07,0xe7,0x70,0x0a,0x00,0x7f,0xff,0xff,0xff,0xff,0xff,0xff,0xff,0xc0,
    0x50,0x02,0xbf,0x08,0x00,0x40,0x01,0xfd,0xfe,0xff,0xff,0xff,0xff,0xff,0xff,0xe0,
    0x80,0x13,0xff,0xfc,0x00,0x80,0x07,0xef,0xfe,0x3f,0xff,0xff,0xff,0xff,0xbf,0xe0,
    0x00,0x1f,0xf7,0x51,0xf6,0x00,0x0f,0xff,0xff,0x9f,0xff,0xff,0xff,0xff,0xdf,0xe0,
    0x08,0x1f,0xff,0xff,0xff,0x00,0x3f,0xff,0x91,0xc3,0xff,0xff,0xff,0xff,0xff,0xf0,
    0x0c,0x3f,0x09,0xff,0xff,0xf0,0x7f,0xf8,0x00,0x21,0xff,0xff,0xff,0xff,0xff,0xf0,
    0x08,0x7c,0x09,0xff,0xff,0xf8,0xff,0xf8,0x00,0x11,0xff,0xff,0xff,0xff,0xff,0xf0,
    0x0d,0x38,0x07,0xff,0xff,0xfe,0x7f,0xf0,0x00,0x0d,0xff,0xff,0xff,0xff,0xff,0xf0,
    0x80,0x30,0x0f,0xff,0xff,0xfe,0xff,0xe0,0x00,0x07,0xff,0xff,0xff,0xff,0xff,0xf8,
    0x00,0x20,0x0f,0xf4,0x00,0x3f,0xbf,0xe0,0x00,0x07,0xff,0xff,0xff,0xff,0xf7,0xf8,
    0x81,0x00,0x3f,0x8b,0x7f,0x57,0x7f,0xc0,0x00,0x03,0xff,0xea,0x53,0xff,0xf3,0xfc,
    0x01,0x40,0x3f,0x6a,0xaa,0xa7,0xff,0xc0,0x00,0x0b,0xff,0x80,0x00,0x7f,0xf1,0xff,
    0x00,0x0e,0x7c,0xb4,0x15,0x57,0xff,0xc2,0xfc,0x09,0xfe,0x00,0x00,0x3f,0xe1,0xfe,
    0x10,0x00,0xde,0xa8,0x02,0xab,0xff,0xef,0xf7,0x15,0xfe,0x00,0x00,0x1f,0xe0,0x7c,
    0x00,0x01,0xf9,0x40,0x00,0x11,0xff,0xc7,0x03,0xe8,0xfc,0x00,0x00,0x0e,0xe0,0x7e,
    0x12,0x01,0xbe,0x00,0x00,0x0b,0xff,0xf9,0xf0,0xaa,0xfc,0x00,0x00,0x0f,0xe0,0x7c,
    0x01,0x00,0xb8,0x00,0x00,0x03,0xff,0xe3,0xc7,0xd3,0x78,0x00,0x00,0x0f,0x70,0x1f,
    0x00,0x03,0x7c,0x00,0x00,0x02,0xff,0xf9,0x70,0xfc,0x78,0x00,0x00,0x07,0x70,0x07,
    0x00,0x03,0x70,0x00,0x00,0x03,0xff,0x80,0x04,0x78,0x78,0x00,0x00,0x07,0x70,0x03,
    0x00,0x01,0x78,0x00,0x00,0x00,0x3f,0xc0,0x00,0x90,0x78,0x00,0x00,0x03,0x30,0x07,
    0x00,0x00,0xa0,0x00,0x00,0x03,0x3f,0xc0,0x00,0xc0,0x78,0x00,0x00,0x03,0x38,0x0c,
    0x00,0x00,0x30,0x00,0x00,0x02,0x3f,0x80,0x00,0x28,0x78,0x00,0x00,0x03,0x30,0x0c,
    0x00,0x01,0x60,0x00,0x00,0x03,0x38,0x00,0x00,0x2c,0x78,0x00,0x00,0x03,0x30,0x1c,
    0x00,0x00,0xe0,0x00,0x00,0x02,0x38,0x00,0x00,0x08,0x00,0x00,0x00,0x02,0x10,0x1c,
    0x00,0x00,0x40,0x00,0x00,0x02,0x3c,0x00,0x00,0x02,0x50,0x00,0x00,0x00,0x10,0x00,
    0x08,0x00,0x40,0x00,0x00,0x00,0x58,0x00,0x00,0x08,0x60,0x00,0x00,0x00,0x10,0x00,
    0x08,0x00,0x60,0x00,0x00,0x00,0x58,0x00,0x00,0x0a,0x70,0x00,0x00,0x00,0x10,0x00,
    0x00,0x01,0x40,0x00,0x00,0x00,0x58,0x00,0x00,0x02,0x70,0x00,0x00,0x01,0x10,0x00,
    0x14,0x01,0x40,0x00,0x00,0x00,0x78,0x00,0x00,0x0e,0x70,0x00,0x00,0x03,0x20,0x00,
    0x00,0x06,0xc0,0x00,0x00,0x00,0x30,0x00,0x00,0x02,0x30,0x00,0x00,0x03,0x20,0x00,
    0x18,0x06,0xe0,0x00,0x00,0x04,0x38,0x00,0x00,0x00,0x30,0x00,0x00,0x02,0x00,0x00,
    0x04,0x06,0xa0,0x00,0x00,0x00,0x78,0x00,0x00,0x02,0x30,0x00,0x00,0x02,0x60,0x00,
    0x0a,0x04,0xf0,0x00,0x00,0x02,0x38,0x00,0x00,0x0c,0x30,0x00,0x00,0x03,0x60,0x00,
    0x06,0x0f,0xf0,0x00,0x00,0x02,0x78,0x0a,0x00,0x07,0x30,0x00,0x00,0x01,0x60,0x00,
    0x0c,0x0f,0xf0,0x00,0x00,0x06,0x38,0x00,0x00,0x03,0xf0,0x00,0x00,0x03,0x70,0x28,
    0x0c,0x0e,0xf8,0x00,0x00,0x02,0x70,0x02,0x00,0x03,0xf4,0x00,0x00,0x03,0xd0,0x20,
    0x04,0x07,0x78,0x00,0x00,0x07,0xf0,0x00,0xc0,0x03,0xf4,0x00,0x00,0x0b,0xe0,0x40,
    0x06,0x07,0xfe,0x00,0x00,0x0f,0xf8,0x00,0xc0,0x07,0xfa,0x00,0x00,0x05,0xe0,0x20,
    0x06,0x07,0xff,0x00,0x00,0x1f,0xf0,0x03,0xc0,0x03,0xf5,0x00,0x00,0x1f,0xe0,0x50,
    0x07,0x87,0xff,0x80,0x00,0x7f,0xf8,0xf6,0xf0,0x01,0xfa,0xc0,0x01,0x4b,0xc0,0x10,
    0x0f,0x83,0xff,0xff,0xff,0xff,0xf1,0x2f,0xc8,0x00,0xfd,0x60,0x15,0x5f,0xc0,0x80,
    0x0f,0xc3,0xff,0xff,0xff,0xff,0xf3,0x7f,0xa8,0x00,0x3e,0xd4,0x75,0x5f,0xc2,0x80,
    0x0f,0xc1,0xff,0xff,0xff,0xff,0xff,0xff,0xfe,0x00,0x1f,0x2a,0x95,0x7f,0xc7,0x80,
    0x0f,0xe3,0xff,0xff,0xff,0xff,0xff,0xff,0xff,0x00,0x0f,0xfc,0x6d,0xef,0x41,0x00,
    0x07,0xf1,0xff,0xff,0xff,0xff,0xfb,0xff,0xcc,0x80,0x07,0xff,0xff,0xe0,0x0f,0x00,
    0x07,0xf0,0xff,0xff,0xff,0xff,0xff,0xff,0xee,0x80,0x07,0xff,0xff,0xe0,0x0f,0x00,
    0x07,0xf0,0xff,0xff,0xff,0xff,0xff,0xff,0xeb,0xc0,0x01,0xff,0xff,0xc0,0x0e,0x00,
    0x03,0xf4,0x7f,0xff,0xff,0xff,0xff,0xff,0xed,0x10,0x80,0x00,0xf6,0x00,0x13,0x00,
    0x07,0xfc,0x7f,0xff,0xff,0xff,0xff,0xff,0xf4,0x82,0x00,0x00,0x03,0x80,0xfe,0x00,
    0x87,0xfe,0x3f,0xff,0xff,0xff,0xff,0xff,0xfe,0xa0,0xa6,0x00,0x00,0x00,0x3a,0x00,
    0x83,0xfe,0xcf,0xff,0xff,0xff,0xff,0xff,0xff,0xe0,0x1e,0x00,0x10,0xcc,0x8c,0x80,
    0x01,0xff,0xef,0xff,0xff,0xff,0xff,0xff,0x6f,0xa0,0x2f,0x00,0x00,0xc2,0x00,0x40,
    0xc1,0xff,0xf3,0xff,0xff,0xff,0xff,0xf9,0xfd,0xc0,0x0f,0xe0,0x07,0xbc,0x3e,0x00,
    0x43,0xff,0xfb,0xff,0xff,0xff,0xff,0xf0,0xfa,0x40,0x17,0x3f,0xc3,0x58,0xed,0x00,
    0xc1,0xff,0xf7,0xff,0xff,0xff,0xff,0xf0,0xf4,0xf0,0x21,0x0f,0xfb,0x33,0xba,0x00,
    0x00,0xff,0xff,0xff,0xff,0xff,0xff,0xe0,0xf8,0x40,0x00,0x55,0xff,0xf7,0x8a,0x00,
    0x38,0xff,0xff,0xff,0xff,0xff,0xff,0x80,0x0e,0x00,0x00,0x00,0x5a,0x08,0xe0,0x20,
    0x50,0xff,0xff,0xff,0xff,0xff,0xff,0x00,0x04,0x00,0x00,0x00,0xd0,0x50,0xd0,0x54,
    0x80,0x7f,0xff,0xff,0xff,0xff,0xff,0x00,0x00,0x00,0x00,0x00,0x30,0xa6,0x30,0xa0,
    0x10,0x3f,0xff,0xff,0xff,0xff,0xff,0x00,0x00,0x00,0x00,0x00,0x20,0xd8,0x00,0x60,
    0x3c,0x31,0xff,0xff,0xff,0xff,0xfe,0x00,0x00,0x00,0x00,0x00,0x01,0x00,0xca,0x00,
    0x3c,0x01,0xff,0xff,0xff,0xff,0xf0,0x00,0x00,0x00,0x00,0x00,0x00,0x00,0x08,0x20,
    0x3c,0x01,0xff,0xff,0xff,0xff,0x80,0x00,0x00,0x00,0x00,0x00,0x00,0x00,0x09,0x60,
    0xbd,0x01,0xff,0xff,0xff,0xff,0x00,0x00,0x00,0x00,0x00,0x00,0x00,0x00,0x0b,0x40,

};

const lv_image_dsc_t frame_001 = {
  .header = {
    .magic = LV_IMAGE_HEADER_MAGIC,
    .cf = LV_COLOR_FORMAT_I1,
    .flags = 0,
    .w = 128,
    .h = 64,
    .stride = 16,
    .reserved_2 = 0,
  },
  .data_size = sizeof(frame_001_map),
  .data = frame_001_map,
  .reserved = NULL,
};
```

## src/frame_002.c
```c
#if defined(LV_LVGL_H_INCLUDE_SIMPLE)
#include "lvgl.h"
#elif defined(LV_LVGL_H_INCLUDE_SYSTEM)
#include <lvgl.h>
#elif defined(LV_BUILD_TEST)
#include "../lvgl.h"
#else
#include <lvgl.h>
#endif

#ifndef LV_ATTRIBUTE_MEM_ALIGN
#define LV_ATTRIBUTE_MEM_ALIGN
#endif

#ifndef LV_ATTRIBUTE_FRAME_002
#define LV_ATTRIBUTE_FRAME_002
#endif

static const
LV_ATTRIBUTE_MEM_ALIGN LV_ATTRIBUTE_LARGE_CONST LV_ATTRIBUTE_FRAME_002
uint8_t frame_002_map[] = {

    0x4c,0x70,0x47,0x00,0x9a,0x65,0x43,0xff,

    0x60,0x00,0x78,0x00,0x00,0x00,0x00,0x00,0x00,0x00,0x00,0x00,0x00,0x00,0x00,0x00,
    0xc0,0x12,0x65,0x48,0x10,0x40,0x00,0x00,0x00,0x00,0x00,0x00,0x00,0x00,0x00,0x00,
    0x80,0x00,0x07,0x80,0x00,0x00,0x00,0x01,0x80,0x34,0x00,0x00,0x00,0x06,0xc0,0x00,
    0x00,0x00,0x07,0x70,0x18,0x40,0x00,0x00,0x5d,0x00,0x00,0x00,0x00,0x40,0xe0,0x00,
    0x00,0x00,0x06,0x10,0x63,0x80,0x00,0x04,0x80,0x02,0x00,0x00,0x00,0x00,0x80,0x00,
    0x00,0x00,0x01,0xc0,0xc0,0x00,0x00,0x74,0x20,0x81,0x80,0x7f,0xc8,0x00,0x00,0x00,
    0x00,0x10,0x01,0x20,0x00,0x00,0x00,0x78,0x00,0x70,0x07,0x03,0x43,0x80,0x00,0x00,
    0x00,0x40,0x07,0xc0,0x3c,0x20,0x21,0x68,0x00,0x08,0x0d,0xdf,0x70,0xc0,0x00,0x00,
    0x80,0x20,0x01,0x79,0x00,0xe0,0x01,0xe0,0x00,0x0c,0x88,0xdf,0xfa,0x20,0x08,0x00,
    0x00,0x40,0x02,0xd4,0x00,0x10,0xc0,0xe0,0x00,0x0e,0x86,0xff,0xff,0x88,0x06,0x00,
    0x00,0x40,0x09,0xa0,0x00,0x0c,0x61,0xc0,0x1c,0x06,0x03,0xef,0xff,0x88,0x02,0x00,
    0x00,0x00,0x0b,0x20,0x00,0x0a,0x21,0xd3,0xfe,0x06,0x0f,0x5e,0x7f,0xe2,0x01,0x80,
    0x00,0x00,0x0e,0x00,0x00,0x06,0x00,0xc7,0xde,0x07,0xf6,0x80,0x00,0x72,0x01,0x00,
    0x02,0x00,0x1c,0x00,0x00,0x06,0x40,0x3f,0xf7,0x03,0xdf,0x00,0x00,0x11,0x80,0x80,
    0x02,0x00,0x0e,0x00,0x00,0x06,0x00,0x3b,0x03,0x86,0x0c,0x00,0x00,0x00,0xc0,0xa0,
    0x00,0x00,0x78,0x00,0x00,0x03,0x04,0x57,0xe0,0xfe,0x16,0x00,0x00,0x00,0x40,0xc0,
    0x00,0x00,0x38,0x00,0x00,0x03,0x04,0x0c,0x00,0xff,0x30,0x00,0x00,0x08,0x20,0x40,
    0x00,0x00,0x70,0x00,0x00,0x02,0x02,0x00,0x10,0xfc,0x20,0x00,0x00,0x02,0x40,0x00,
    0x00,0x00,0x70,0x00,0x00,0x03,0x18,0x00,0x04,0xe8,0x28,0x00,0x00,0x0e,0x40,0x00,
    0x00,0x20,0x78,0x00,0x00,0x03,0x08,0x00,0x00,0x58,0x78,0x00,0x00,0x00,0x00,0x00,
    0x00,0x00,0xb8,0x00,0x00,0x06,0x30,0x00,0x00,0x08,0x2c,0x00,0x00,0x00,0x00,0x00,
    0x00,0x00,0x38,0x00,0x00,0x07,0x60,0x00,0x00,0x00,0x2c,0x00,0x00,0x03,0x00,0x00,
    0x00,0x00,0x78,0x00,0x00,0x02,0x70,0x00,0x00,0x04,0x38,0x00,0x00,0x00,0x00,0x00,
    0x08,0x00,0xf8,0x00,0x00,0x00,0x60,0x00,0x00,0x00,0x30,0x00,0x00,0x02,0x20,0x00,
    0x00,0x00,0x70,0x00,0x00,0x00,0x20,0x00,0x00,0x00,0x78,0x00,0x00,0x03,0x00,0x00,
    0x08,0x00,0x10,0x00,0x00,0x00,0x00,0x00,0x00,0x00,0x0c,0x00,0x00,0x02,0x00,0x00,
    0x08,0x01,0x60,0x00,0x00,0x00,0x40,0x00,0x00,0x00,0x28,0x00,0x00,0x02,0x20,0x00,
    0x00,0x08,0x50,0x00,0x00,0x00,0x60,0x00,0x00,0x00,0x78,0x00,0x00,0x03,0x00,0x00,
    0x00,0x06,0x30,0x00,0x00,0x00,0x60,0x00,0x00,0x00,0x78,0x00,0x00,0x03,0x20,0x00,
    0x04,0x00,0x38,0x00,0x00,0x00,0x20,0x00,0x00,0x00,0x10,0x00,0x00,0x03,0x20,0x00,
    0x04,0x00,0x78,0x00,0x00,0x04,0x10,0x00,0x00,0x0e,0x00,0x00,0x00,0x02,0x00,0x00,
    0x00,0x00,0x70,0x00,0x00,0x00,0x10,0x00,0x00,0x00,0x18,0x00,0x00,0x02,0x00,0x00,
    0x00,0x00,0x30,0x00,0x00,0x06,0x40,0x00,0x00,0x02,0x10,0x00,0x00,0x02,0x00,0x00,
    0x08,0x01,0x08,0x00,0x00,0x06,0x60,0x0a,0x00,0x00,0x08,0x00,0x00,0x03,0x00,0x00,
    0x00,0x00,0x20,0x00,0x00,0x04,0x20,0x00,0x00,0x00,0x08,0x00,0x00,0x06,0x20,0x08,
    0x00,0x00,0x02,0x00,0x00,0x0e,0x60,0x02,0x00,0x02,0x00,0x00,0x00,0x06,0x00,0x00,
    0x00,0x00,0x0c,0x00,0x00,0x0f,0xc0,0x00,0xc0,0x00,0x00,0x00,0x00,0x0c,0x00,0x00,
    0x00,0x00,0x0f,0x00,0x00,0x1f,0x80,0x00,0x40,0x04,0x10,0x00,0x00,0x00,0x40,0x00,
    0x01,0x00,0x4f,0x80,0x00,0x3c,0x00,0x03,0xc0,0x00,0x20,0x00,0x00,0x0c,0x20,0x10,
    0x00,0x00,0x13,0xe0,0x01,0xfc,0x00,0xc6,0x00,0x00,0x1c,0x00,0x00,0x01,0x80,0x00,
    0x00,0x80,0x1f,0xff,0xff,0xe6,0x01,0x20,0x70,0x00,0x00,0x00,0x00,0x3a,0x01,0x40,
    0x00,0xc0,0x3e,0xff,0xff,0xae,0x03,0x24,0x74,0x00,0x56,0x00,0x00,0x70,0x21,0x60,
    0x00,0x40,0x07,0xc1,0xff,0xe0,0x06,0xc0,0x31,0x00,0x33,0x10,0x00,0xa2,0x01,0x80,
    0x00,0x20,0x07,0xff,0x3f,0xf0,0x04,0x00,0x10,0x80,0x01,0x28,0x08,0x80,0x44,0x80,
    0x00,0x50,0x04,0xcf,0xff,0x80,0x11,0x00,0x1f,0x00,0x00,0x1b,0xa0,0x10,0x00,0x80,
    0x00,0x30,0x01,0xff,0xf0,0x00,0x14,0x00,0x41,0x00,0x00,0x00,0xac,0x00,0x83,0x00,
    0x00,0x10,0x00,0xff,0x00,0x00,0x3c,0x00,0x16,0x00,0x00,0xa1,0x80,0x00,0x06,0x00,
    0x00,0x30,0x00,0x20,0x00,0x00,0x6c,0x00,0x02,0x10,0x00,0x10,0xea,0x00,0xcf,0x00,
    0x00,0x10,0x00,0x00,0x10,0x02,0xec,0x00,0x08,0x4d,0x00,0x00,0x13,0x80,0x63,0xa0,
    0x00,0x2e,0x00,0x00,0x00,0x00,0xca,0x00,0x00,0x01,0x00,0x00,0x01,0x08,0x12,0x10,
    0x00,0x0b,0x00,0x00,0x00,0x08,0x00,0x00,0x00,0x10,0x40,0x00,0x10,0x40,0x1c,0x20,
    0x00,0x2d,0x60,0x00,0x00,0x5c,0x00,0x00,0x00,0x00,0xe0,0x00,0x01,0xc0,0x08,0x50,
    0x00,0x00,0xb5,0x20,0x00,0x8f,0x00,0x00,0x00,0x23,0x80,0x00,0x04,0x50,0x22,0x0e,
    0x00,0x00,0x21,0x0a,0x07,0x28,0x00,0x00,0x00,0x00,0x4c,0xc0,0x00,0x00,0x8e,0x03,
    0x00,0x00,0x60,0xdf,0x6f,0xe0,0x00,0x00,0x00,0x00,0x8b,0x10,0x00,0x0c,0xc4,0x0e,
    0x00,0x00,0x2a,0xaf,0xa0,0x40,0x00,0x00,0x00,0x10,0x05,0x0b,0x00,0x10,0x00,0x0c,
    0x00,0x00,0x00,0x00,0x50,0x00,0x00,0x00,0x00,0x00,0x00,0xe3,0xb5,0x7e,0x40,0x00,
    0x00,0x00,0x00,0x50,0x20,0x00,0x00,0x00,0x00,0x00,0x00,0x00,0x1d,0x3d,0x80,0x00,
    0x00,0x00,0x00,0x00,0x00,0x00,0x00,0x00,0x00,0x00,0x00,0x00,0x30,0x58,0xa0,0x00,
    0x00,0x00,0x00,0x00,0x00,0x00,0x00,0x00,0x00,0x00,0x00,0x00,0x20,0x35,0xa0,0x00,
    0x04,0x00,0x00,0x00,0x00,0x00,0x00,0x00,0x00,0x00,0x00,0x00,0x00,0x0f,0x00,0x00,
    0x04,0x00,0x00,0x00,0x00,0x00,0x00,0x00,0x00,0x00,0x00,0x00,0x00,0x0f,0xe0,0x00,
    0x04,0x00,0x00,0x00,0x00,0x00,0x00,0x00,0x00,0x00,0x00,0x00,0x00,0x0c,0xa0,0x00,
    0x00,0x00,0x00,0x00,0x00,0x00,0x00,0x00,0x00,0x00,0x00,0x00,0x00,0x0c,0x00,0x20,

};

const lv_image_dsc_t frame_002 = {
  .header = {
    .magic = LV_IMAGE_HEADER_MAGIC,
    .cf = LV_COLOR_FORMAT_I1,
    .flags = 0,
    .w = 128,
    .h = 64,
    .stride = 16,
    .reserved_2 = 0,
  },
  .data_size = sizeof(frame_002_map),
  .data = frame_002_map,
  .reserved = NULL,
};
```

## src/frame_003.c
```c
#if defined(LV_LVGL_H_INCLUDE_SIMPLE)
#include "lvgl.h"
#elif defined(LV_LVGL_H_INCLUDE_SYSTEM)
#include <lvgl.h>
#elif defined(LV_BUILD_TEST)
#include "../lvgl.h"
#else
#include <lvgl.h>
#endif

#ifndef LV_ATTRIBUTE_MEM_ALIGN
#define LV_ATTRIBUTE_MEM_ALIGN
#endif

#ifndef LV_ATTRIBUTE_FRAME_003
#define LV_ATTRIBUTE_FRAME_003
#endif

static const
LV_ATTRIBUTE_MEM_ALIGN LV_ATTRIBUTE_LARGE_CONST LV_ATTRIBUTE_FRAME_003
uint8_t frame_003_map[] = {

    0x4c,0x70,0x47,0x00,0xa2,0x6a,0x46,0xff,

    0x00,0x00,0x00,0x00,0x20,0x00,0x00,0x00,0x02,0x00,0x00,0x00,0x00,0x00,0x00,0x00,
    0x10,0x00,0x20,0x40,0x10,0x00,0x00,0x3c,0x03,0xd0,0x00,0x00,0x00,0x00,0x00,0x00,
    0x00,0x02,0xc0,0x00,0x00,0x80,0x00,0xe3,0x18,0x30,0x00,0x00,0x00,0x00,0x00,0x00,
    0x00,0x14,0x20,0x51,0xfe,0x40,0x03,0xdb,0xfe,0x38,0x00,0x01,0xc0,0x00,0x00,0x00,
    0x00,0x00,0x00,0x40,0x60,0x80,0x07,0xff,0x7f,0xdc,0x00,0x7f,0xf8,0x00,0x00,0x00,
    0x00,0x00,0x01,0x80,0x04,0x10,0x07,0xfc,0x0f,0xe7,0x81,0xff,0xfe,0x00,0x00,0x00,
    0x00,0x00,0x00,0x84,0x02,0x88,0x07,0xfc,0x00,0xf7,0x79,0x3f,0xe3,0x00,0x10,0x00,
    0x00,0x00,0x00,0x26,0x12,0x43,0x1f,0xf0,0x00,0x3f,0x00,0xff,0xfc,0xe0,0x00,0x00,
    0x00,0x00,0x0d,0xb4,0x81,0xd6,0x0f,0xf0,0x00,0x1f,0x61,0xff,0xff,0x00,0x00,0x00,
    0x00,0xc0,0x0b,0x60,0x00,0xfb,0xcf,0xf0,0x00,0x0f,0x07,0xff,0xff,0x80,0x00,0x00,
    0x01,0x40,0x3f,0xd0,0x00,0xb8,0x67,0xe3,0xf4,0x07,0x0f,0xff,0xbd,0xe0,0x00,0x00,
    0x00,0x00,0xff,0xc0,0x00,0x1c,0x67,0xff,0xfc,0x07,0x0f,0xe0,0x00,0xe4,0x00,0x00,
    0x00,0x07,0x6f,0x80,0x00,0x0e,0xe7,0xff,0x37,0x07,0x0f,0x00,0x00,0x40,0x00,0x00,
    0x02,0x00,0xdf,0x80,0x00,0x06,0x2b,0xfc,0x83,0xff,0x6c,0x00,0x00,0x19,0x00,0x00,
    0x02,0x01,0xff,0x00,0x00,0x07,0x21,0xab,0xf3,0xff,0x3a,0x00,0x00,0x01,0x40,0x00,
    0x00,0x01,0xff,0x00,0x00,0x07,0x24,0x4d,0x9f,0xff,0x10,0x00,0x00,0x0c,0xc0,0x00,
    0x01,0x01,0xff,0x00,0x00,0x07,0x2c,0x00,0x3f,0xfe,0x30,0x00,0x00,0x1c,0x00,0x40,
    0x09,0x03,0xbe,0x00,0x00,0x07,0x20,0x00,0x0f,0xfc,0x38,0x00,0x00,0x0e,0x50,0x10,
    0x01,0x03,0xfe,0x00,0x00,0x07,0x30,0x00,0x0b,0xfc,0x20,0x00,0x00,0x0e,0x60,0x1c,
    0x00,0x23,0xbc,0x00,0x00,0x07,0x30,0x00,0x01,0xf4,0x70,0x00,0x00,0x0e,0x20,0x00,
    0x04,0x03,0xfc,0x00,0x00,0x07,0x00,0x00,0x00,0xfc,0x20,0x00,0x00,0x0e,0x00,0x00,
    0x04,0x03,0xfc,0x00,0x00,0x06,0x60,0x00,0x00,0x1e,0x28,0x00,0x00,0x06,0x00,0x00,
    0x04,0x03,0xfc,0x00,0x00,0x06,0x60,0x00,0x00,0x1e,0x34,0x00,0x00,0x07,0x20,0x18,
    0x04,0x03,0x7c,0x00,0x00,0x04,0x20,0x00,0x00,0x1e,0x3c,0x00,0x00,0x07,0x00,0x10,
    0x00,0x07,0x7c,0x00,0x00,0x00,0x40,0x00,0x00,0x00,0x78,0x00,0x00,0x07,0x20,0x04,
    0x0a,0x07,0x7c,0x00,0x00,0x00,0x40,0x00,0x00,0x00,0x3c,0x00,0x00,0x07,0x30,0x14,
    0x0a,0x06,0x7c,0x00,0x00,0x00,0x00,0x00,0x00,0x02,0x3c,0x00,0x00,0x03,0x00,0x1c,
    0x02,0x07,0x7c,0x00,0x00,0x00,0x00,0x00,0x00,0x02,0x3c,0x00,0x00,0x06,0x20,0x1c,
    0x00,0x03,0x7c,0x00,0x00,0x00,0x00,0x00,0x00,0x0a,0x3c,0x00,0x00,0x06,0x00,0x10,
    0x04,0x03,0x7c,0x00,0x00,0x00,0x00,0x00,0x00,0x02,0x38,0x00,0x00,0x06,0x00,0x08,
    0x00,0x03,0x3c,0x00,0x00,0x04,0x00,0x00,0x00,0x0a,0x38,0x00,0x00,0x06,0x00,0x18,
    0x04,0x03,0x3c,0x00,0x00,0x06,0x00,0x00,0x00,0x02,0x38,0x00,0x00,0x07,0x00,0x20,
    0x00,0x03,0x3c,0x00,0x00,0x06,0x00,0x00,0x00,0x0e,0x38,0x00,0x00,0x07,0x40,0x08,
    0x06,0x02,0x3c,0x00,0x00,0x06,0x20,0x00,0x00,0x06,0x38,0x00,0x00,0x06,0x60,0x00,
    0x04,0x03,0x9c,0x00,0x00,0x07,0x20,0x00,0x00,0x02,0x78,0x00,0x00,0x07,0x40,0x20,
    0x04,0x01,0xac,0x00,0x00,0x07,0x20,0x00,0x00,0x03,0x78,0x00,0x00,0x0e,0x00,0x00,
    0x02,0x00,0x8c,0x00,0x00,0x07,0x60,0x00,0x00,0x01,0x78,0x00,0x00,0x0e,0x00,0x40,
    0x03,0x00,0x0e,0x00,0x00,0x0f,0x60,0x00,0x10,0x03,0x38,0x00,0x00,0x0c,0x20,0x00,
    0x01,0x00,0x4e,0x00,0x00,0x1f,0xc0,0x00,0x30,0x03,0xbc,0x00,0x00,0x1c,0x00,0x80,
    0x01,0x00,0x27,0x80,0x00,0x3f,0xc0,0x39,0x00,0x01,0x9a,0x00,0x00,0x1b,0x00,0x00,
    0x00,0x80,0x1f,0xf0,0x00,0xff,0x80,0x00,0x06,0x00,0xdc,0x00,0x00,0x1c,0x01,0x40,
    0x00,0x80,0x17,0xff,0xff,0xff,0x80,0x58,0x13,0x00,0x7e,0x00,0x00,0x00,0x20,0x40,
    0x00,0x40,0x0f,0xff,0xff,0xff,0x80,0x68,0x00,0x00,0x37,0x10,0x00,0x60,0x00,0x00,
    0x00,0x00,0x09,0xff,0xff,0xfa,0x02,0xc0,0x00,0x80,0x03,0xf1,0xb3,0xb1,0x40,0x00,
    0x00,0x00,0x07,0xff,0xff,0xf8,0x03,0xb0,0x22,0x60,0x06,0x11,0xf0,0x82,0x00,0x00,
    0x00,0x20,0x01,0xff,0xff,0x80,0x03,0x00,0x03,0x60,0x04,0xd0,0x00,0x81,0x00,0x00,
    0x00,0x00,0x00,0xff,0xfe,0x00,0x0f,0x80,0x01,0x30,0x01,0x9f,0x60,0xd0,0xc0,0x00,
    0x00,0x20,0x00,0x3f,0xfc,0x00,0x9c,0x00,0x12,0x10,0x00,0x1e,0x2e,0x30,0x02,0x00,
    0x00,0x08,0x00,0x60,0x10,0x01,0x10,0x00,0x03,0x60,0x00,0x00,0x11,0xed,0x42,0x80,
    0x00,0x04,0x00,0x00,0x00,0x03,0xf2,0x00,0x00,0x21,0x00,0x00,0x01,0xef,0xf0,0x00,
    0x00,0x01,0x00,0x00,0x00,0x06,0xe0,0x00,0x00,0x10,0x00,0x00,0x10,0x6d,0x0c,0x80,
    0x80,0x20,0x80,0x00,0x00,0x0f,0xc0,0x00,0x00,0x00,0x20,0x00,0x01,0x97,0x28,0x00,
    0x00,0x02,0xc6,0x00,0x00,0x7c,0xc0,0x00,0x00,0x13,0x00,0x00,0x02,0x7f,0xf3,0x00,
    0x80,0x09,0x5a,0x10,0x00,0xff,0x80,0x00,0x00,0x00,0x04,0x40,0x03,0x5e,0xec,0x00,
    0x00,0x01,0x37,0x80,0x92,0x9c,0x00,0x00,0x00,0x00,0x80,0x10,0x00,0x0f,0xf9,0x00,
    0x00,0x00,0x15,0xdf,0xff,0xb0,0x00,0x00,0x00,0x00,0x04,0x00,0x00,0x0f,0xe2,0x00,
    0x00,0x00,0x08,0x5f,0xaf,0x00,0x00,0x00,0x00,0x00,0x00,0x40,0x44,0x08,0x00,0x00,
    0x00,0x00,0x00,0x09,0x85,0x00,0x00,0x00,0x00,0x00,0x00,0x00,0x00,0x00,0x00,0x00,
    0x00,0x00,0x00,0xa0,0x00,0x00,0x00,0x00,0x00,0x00,0x00,0x00,0x10,0x00,0x00,0x00,
    0x00,0x00,0x00,0x00,0x00,0x00,0x00,0x00,0x00,0x00,0x00,0x00,0x00,0x00,0x00,0x00,
    0x00,0x00,0x00,0x00,0x00,0x00,0x00,0x00,0x00,0x00,0x00,0x00,0x00,0x00,0x00,0x00,
    0x00,0x00,0x00,0x00,0x00,0x00,0x00,0x00,0x00,0x00,0x00,0x00,0x00,0x00,0x00,0x00,
    0x00,0x00,0x00,0x00,0x00,0x00,0x00,0x00,0x00,0x00,0x00,0x00,0x00,0x00,0x00,0x00,
    0x00,0x00,0x00,0x00,0x00,0x00,0x00,0x00,0x00,0x00,0x00,0x00,0x00,0x00,0x20,0x00,

};

const lv_image_dsc_t frame_003 = {
  .header = {
    .magic = LV_IMAGE_HEADER_MAGIC,
    .cf = LV_COLOR_FORMAT_I1,
    .flags = 0,
    .w = 128,
    .h = 64,
    .stride = 16,
    .reserved_2 = 0,
  },
  .data_size = sizeof(frame_003_map),
  .data = frame_003_map,
  .reserved = NULL,
};
```

## src/frame_004.c
```c
#if defined(LV_LVGL_H_INCLUDE_SIMPLE)
#include "lvgl.h"
#elif defined(LV_LVGL_H_INCLUDE_SYSTEM)
#include <lvgl.h>
#elif defined(LV_BUILD_TEST)
#include "../lvgl.h"
#else
#include <lvgl.h>
#endif

#ifndef LV_ATTRIBUTE_MEM_ALIGN
#define LV_ATTRIBUTE_MEM_ALIGN
#endif

#ifndef LV_ATTRIBUTE_FRAME_004
#define LV_ATTRIBUTE_FRAME_004
#endif

static const
LV_ATTRIBUTE_MEM_ALIGN LV_ATTRIBUTE_LARGE_CONST LV_ATTRIBUTE_FRAME_004
uint8_t frame_004_map[] = {

    0x4c,0x70,0x47,0x00,0xa2,0x68,0x45,0xff,

    0x00,0x00,0x00,0x00,0x00,0x00,0x00,0x00,0x0c,0x00,0x00,0x00,0x00,0x00,0x00,0x00,
    0x00,0x00,0x00,0x00,0x00,0x00,0x00,0x20,0x00,0x00,0x00,0x00,0x00,0x08,0x00,0x00,
    0x00,0x00,0x00,0x00,0x00,0x00,0x00,0x80,0x00,0x20,0x00,0x00,0x80,0x84,0xc0,0x00,
    0x00,0x00,0x00,0x00,0x00,0x00,0x02,0x00,0x1c,0x00,0x00,0x07,0xe0,0x81,0xa0,0x00,
    0x00,0x00,0x00,0x00,0x00,0x00,0x04,0x00,0x04,0x14,0x00,0xe0,0xfe,0x00,0x80,0x00,
    0x00,0x00,0x00,0x00,0x00,0x10,0x1c,0x80,0x04,0x4c,0x12,0xc0,0x1f,0x80,0x00,0x00,
    0x00,0x00,0x00,0x00,0x00,0x16,0xbe,0x88,0x00,0x61,0x4d,0xf0,0x19,0xc0,0x10,0x00,
    0x00,0x00,0x00,0x00,0x00,0x01,0x4f,0x00,0x00,0x3d,0x31,0x7f,0xfe,0x30,0x00,0x00,
    0x00,0x00,0x08,0x00,0x00,0x04,0x1e,0x00,0x00,0x1b,0x63,0xff,0x7f,0x98,0x00,0x00,
    0x00,0x00,0x08,0x04,0x00,0x02,0xaf,0x80,0x00,0x1e,0x07,0xef,0xff,0xc8,0x00,0x00,
    0x00,0x00,0x18,0x00,0x00,0x08,0xdf,0x00,0x04,0x0e,0x07,0x60,0x03,0xe0,0x00,0x00,
    0x00,0x00,0xd0,0x00,0x00,0x08,0xcf,0x8d,0x28,0x0e,0x1f,0x00,0x00,0x60,0x00,0x00,
    0x00,0x00,0x60,0x00,0x00,0x02,0xcf,0x38,0x02,0x5e,0x0c,0x00,0x00,0x70,0x00,0x00,
    0x00,0x00,0x00,0x00,0x00,0x04,0x4f,0xc0,0x22,0x7e,0x3e,0x00,0x00,0x10,0x00,0x00,
    0x00,0x00,0x44,0x00,0x00,0x04,0x67,0x60,0x00,0x7e,0x34,0x00,0x00,0x00,0x00,0x00,
    0x00,0x08,0xc8,0x00,0x00,0x04,0x6f,0x40,0x00,0x5c,0x34,0x00,0x00,0x00,0x00,0x00,
    0x00,0x00,0x70,0x00,0x00,0x06,0x0f,0x00,0x00,0x42,0x28,0x00,0x00,0x00,0x00,0x00,
    0x00,0x01,0x30,0x00,0x00,0x06,0x10,0x00,0x00,0x00,0x20,0x00,0x00,0x08,0x00,0x00,
    0x00,0x00,0x00,0x00,0x00,0x02,0x18,0x00,0x00,0x10,0x30,0x00,0x00,0x00,0x00,0x00,
    0x00,0x00,0x08,0x00,0x00,0x06,0x30,0x00,0x00,0x00,0x20,0x00,0x00,0x00,0x00,0x00,
    0x00,0x00,0x00,0x00,0x00,0x02,0x00,0x00,0x00,0x00,0x20,0x00,0x00,0x00,0x00,0x00,
    0x00,0x00,0x00,0x00,0x00,0x00,0x30,0x00,0x00,0x00,0x30,0x00,0x00,0x00,0x00,0x00,
    0x00,0x00,0x00,0x00,0x00,0x00,0x30,0x00,0x00,0x00,0x20,0x00,0x00,0x04,0x00,0x00,
    0x00,0x00,0x30,0x00,0x00,0x00,0x60,0x00,0x00,0x04,0x38,0x00,0x00,0x02,0x00,0x00,
    0x00,0x00,0x00,0x00,0x00,0x00,0x50,0x00,0x00,0x00,0x20,0x00,0x00,0x04,0x00,0x00,
    0x00,0x00,0x00,0x00,0x00,0x00,0x00,0x00,0x00,0x00,0x28,0x00,0x00,0x00,0x00,0x00,
    0x00,0x00,0x10,0x00,0x00,0x00,0x00,0x00,0x00,0x00,0x08,0x00,0x00,0x04,0x00,0x00,
    0x00,0x00,0x00,0x00,0x00,0x00,0x00,0x00,0x00,0x00,0x10,0x00,0x00,0x01,0x00,0x00,
    0x00,0x00,0x08,0x00,0x00,0x00,0x00,0x00,0x00,0x00,0x10,0x00,0x00,0x04,0x00,0x00,
    0x00,0x00,0x00,0x00,0x00,0x00,0x00,0x00,0x00,0x00,0x10,0x00,0x00,0x07,0x00,0x00,
    0x00,0x00,0x00,0x00,0x00,0x00,0x00,0x00,0x00,0x00,0x10,0x00,0x00,0x07,0x40,0x00,
    0x00,0x00,0x00,0x00,0x00,0x06,0x00,0x00,0x00,0x00,0x18,0x00,0x00,0x02,0x40,0x00,
    0x00,0x00,0x80,0x00,0x00,0x07,0x00,0x00,0x00,0x00,0x14,0x00,0x00,0x06,0x20,0x00,
    0x06,0x00,0x80,0x00,0x00,0x03,0x40,0x00,0x00,0x00,0x04,0x00,0x00,0x06,0x00,0x00,
    0x04,0x00,0x00,0x00,0x00,0x02,0x10,0x00,0x00,0x00,0x2c,0x00,0x00,0x04,0x00,0x00,
    0x04,0x00,0x00,0x00,0x00,0x02,0x10,0x00,0x00,0x02,0x3c,0x00,0x00,0x06,0x00,0x00,
    0x02,0x00,0x00,0x00,0x00,0x02,0x18,0x00,0x00,0x00,0xb0,0x00,0x00,0x0c,0x60,0x00,
    0x03,0x00,0x00,0x00,0x00,0x00,0xb0,0x00,0x00,0x00,0x94,0x00,0x00,0x18,0x00,0x00,
    0x01,0x00,0x84,0x00,0x00,0x02,0xe0,0x00,0x30,0x00,0x40,0x00,0x00,0x09,0x00,0x00,
    0x01,0x00,0x44,0x00,0x00,0x07,0xe0,0x08,0x00,0x00,0x4c,0x00,0x00,0x11,0x00,0x00,
    0x00,0x80,0x20,0x00,0x00,0x0e,0xc0,0x00,0x06,0x00,0x0f,0x00,0x00,0x38,0x40,0x00,
    0x00,0x80,0x18,0x00,0x00,0x03,0x80,0x00,0x01,0x00,0x1e,0x40,0x00,0xe0,0x00,0x00,
    0x00,0x40,0x09,0x88,0x00,0x37,0x01,0xb0,0x00,0x00,0x03,0x0f,0xc7,0xc1,0x81,0x80,
    0x00,0x40,0x03,0x40,0x30,0x8d,0x01,0x90,0x00,0x80,0x02,0x7f,0xf7,0x84,0x40,0x80,
    0x00,0x00,0x04,0x11,0x0c,0x17,0x00,0x00,0x02,0x20,0x01,0x0f,0xf0,0x80,0x00,0x80,
    0x00,0x20,0x00,0x21,0x03,0x7c,0x00,0x00,0x01,0x20,0x00,0xd0,0x50,0x22,0x02,0x00,
    0x00,0x00,0x00,0x00,0x07,0x80,0x03,0x00,0x01,0x30,0x00,0x1f,0xd1,0x80,0x00,0x00,
    0x00,0x24,0x00,0x06,0x03,0x00,0x03,0xa0,0x01,0x00,0x00,0x1e,0x30,0x00,0x00,0x00,
    0x00,0x00,0x00,0x17,0xf8,0x00,0x13,0x00,0x00,0x00,0x00,0x00,0x02,0x00,0x22,0x00,
    0x00,0x00,0x00,0x20,0x00,0x00,0x16,0x00,0x00,0x00,0x00,0x00,0x20,0x00,0x00,0x00,
    0x00,0x00,0x00,0x00,0x00,0x01,0x3c,0x00,0x00,0x00,0x00,0x00,0x00,0x00,0x00,0x00,
    0x00,0x21,0x00,0x00,0x00,0x00,0xfa,0x00,0x00,0x00,0x00,0x00,0x00,0x00,0x00,0x00,
    0x00,0x01,0x00,0x00,0x00,0x03,0x00,0x00,0x00,0x00,0x00,0x00,0x00,0x00,0x00,0x00,
    0x00,0x06,0x80,0x00,0x00,0x06,0x00,0x00,0x00,0x00,0x00,0x00,0x00,0x00,0x00,0x00,
    0x00,0x02,0xc3,0xa0,0x00,0x76,0x00,0x00,0x00,0x00,0x00,0x00,0x00,0x00,0x40,0x00,
    0x00,0x00,0x01,0x70,0x05,0x08,0x00,0x00,0x00,0x00,0x20,0x00,0x00,0x00,0x00,0x00,
    0x00,0x00,0x0f,0x00,0xf0,0x18,0x00,0x00,0x00,0x00,0x01,0x40,0x74,0x07,0x50,0x00,
    0x00,0x00,0x00,0xa6,0xf8,0x00,0x00,0x00,0x00,0x00,0x00,0x00,0x10,0x04,0xb0,0x00,
    0x00,0x00,0x00,0x05,0x38,0x00,0x00,0x00,0x00,0x00,0x00,0x00,0x10,0x08,0x80,0x00,
    0x00,0x00,0x00,0x50,0x00,0x00,0x00,0x00,0x00,0x00,0x00,0x00,0x00,0x00,0x90,0x00,
    0x00,0x00,0x00,0x00,0x00,0x00,0x00,0x00,0x00,0x00,0x00,0x00,0x00,0x00,0x08,0x00,
    0x00,0x00,0x00,0x00,0x00,0x00,0x00,0x00,0x00,0x00,0x00,0x00,0x00,0x01,0x20,0x00,
    0x00,0x00,0x00,0x00,0x00,0x00,0x00,0x00,0x00,0x00,0x00,0x00,0x00,0x00,0xa0,0x00,
    0x00,0x00,0x00,0x00,0x00,0x00,0x00,0x00,0x00,0x00,0x00,0x00,0x00,0x00,0x0a,0x20,

};

const lv_image_dsc_t frame_004 = {
  .header = {
    .magic = LV_IMAGE_HEADER_MAGIC,
    .cf = LV_COLOR_FORMAT_I1,
    .flags = 0,
    .w = 128,
    .h = 64,
    .stride = 16,
    .reserved_2 = 0,
  },
  .data_size = sizeof(frame_004_map),
  .data = frame_004_map,
  .reserved = NULL,
};
```
